## drivers/input/fingerprint/Kconfig
```kconfig
#
#Fingerprint
#
menu "Finger support"
	depends on !UML

config MTK_FINGERPRINT
	tristate "Mediatek Fingerprint"
	default n
	---help---
	Fingerprint mtk driver enable/disable in the kernel.
	Say Y here if you want to use mediatek fingerprint driver,
	fingerprint driver will support fingerprint function in REE,
	it supports FPC's 102x/104x device.

if MTK_FINGERPRINT
config FINGERPRINT_MICROARRAY_FP
	tristate "microarray Fingerprint"
	default n
config FINGERPRINT_GSL6161_FP
	tristate "gsl6161 Fingerprint"
	default n
config FINGERPRINT_GOODIX_FP
	tristate "goodix Fingerprint"
	default n
	---help---
	Goodix Fingerprint chip GF516/GF318GF316M/GF616M/GF318M  no tee driver
config FINGERPRINT_FPC_FP
    tristate "fpc Fingerprint"
    default n
config FINGERPRINT_GX368_FP
    tristate "goodix Fingerprint"
    default n
config FINGERPRINT_GX368_OTP_FP
    tristate "goodix gx368 otp Fingerprint"
    default n
config FINGERPRINT_SW9551
	tristate "xinwei Fingerprint"
	default n
endif
endmenu
```

## drivers/input/fingerprint/sw9551_fp/Kconfig
```kconfig
config FINGERPRINT_SUNWAVE_9551
        bool "FINGERPRINT_SUNWAVE_9551"
        default n
```

## drivers/input/touchscreen/mediatek/Kconfig
```kconfig
#
# Touchscreen driver configuration
#
menuconfig INPUT_TOUCHSCREEN
	bool "Touchscreens"
	help
	  Say Y here, and a list of supported touchscreens will be displayed.
	  This option doesn't affect the kernel.

	  If unsure, say Y.

if INPUT_TOUCHSCREEN

config TOUCHSCREEN_MTK
	tristate "MediaTek Touch Panel Driver"
	default n
	help
	  Say Y here if you have MediaTek touch panel.

	  If unsure, say N.

	  To compile this dirver as a module, choose M here: the
	  module will be called.

config TOUCHSCREEN_MTK_FOCALTECH
	bool "FT5X0X for Mediatek package"
	default n
	help
	  Say Y here if you have focaltech ouch panel.

	  If unsure, say N.

	  To compile this dirver as a module, choose M here: the
	  module will be called.

source "drivers/input/touchscreen/mediatek/focaltech/Kconfig"

endif
```

## drivers/misc/mediatek/accelerometer/mxc400x_new/Kconfig
```kconfig
config MTK_MXC400X_NEW
	bool "MXC400X for MediaTek package"
	default n
	help
	  It support different accelerometer sensor.
          If this option is set,
	  it will support
          Mxc400x Accelerometer.
```

## drivers/misc/mediatek/magnetometer/qmc6983-new/Kconfig
```kconfig
config MTK_QMC6983_NEW
	bool "QMC6983 for MediaTek package"
	default n
	help
	  It support different magnetometer sensor.
          If this option is set,
	  it will support
          QMC6983 magnetometer.
```
